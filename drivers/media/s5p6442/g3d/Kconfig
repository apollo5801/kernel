## drivers/media/s5p6442/g3d/Kconfig
```kconfig
#
# G3D subsystem configuration
#

#menu "G3D OpenFIMG Support"

config VIDEO_OPENFIMG_G3D
	tristate "OpenFIMG driver"
	depends on CPU_S5P6442
	default n
	help

#endmenu
```

## drivers/staging/compcache/Kconfig
```kconfig
menu "ZRAM" 

config ZRAM
 	tristate "Compressed RAM block device support"
	depends on BLOCK
 	select LZO_COMPRESS
 	select LZO_DECOMPRESS
 	default n

endmenu
```
